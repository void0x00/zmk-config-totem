#include <behaviors.dtsi>
#include <dt-bindings/zmk/keys.h>
#include <dt-bindings/zmk/bt.h>
// #include <dt-bindings/zmk/outputs.h>
// #include <dt-bindings/zmk/rgb.h>
// #include <dt-bindings/zmk/ext_power.h>

// Layer aliases
#define DEF 0
#define NUM 1
#define SYM 2
#define NAV 3
#define MSE 4

// Desktop and tab navigation shortcuts
#define D_LT   LC(LG(LEFT))
#define D_RT   LC(LG(RIGHT))
#define TAB_RT LC(TAB)
#define TAB_LT LC(LS(TAB))

#include "combos_swap.dtsi"

#ifdef MOUSE_KEYS
#    include "mouse.dtsi"
#    define MS_ACT(key) &lt MSE key
#else
#    define MS_ACT(key) &kp key
#endif

&mt {
    flavor = "hold-preferred";
    tapping-term-ms = <150>;
};

&lt {
    flavor = "balanced";
    tapping-term-ms = <150>;
};

&caps_word {
    continue-list = <UNDERSCORE MINUS BSPC DEL N1 N2 N3 N4 N5 N6 N7 N8 N9 N0>;
};

/ {
    behaviors {
        aml: alpha_mods_l {
            compatible = "zmk,behavior-hold-tap";
            #binding-cells = <2>;
            tapping-term-ms = <250>;
            quick-tap-ms = <150>;
            flavor = "balanced";
            bindings = <&kp>, <&kp>;
            hold-trigger-key-positions = <KEYS_R THUMBS>;
            hold-trigger-on-release;
            require-prior-idle-ms = <100>;
        };
        asl: alpha_shift_l {
            compatible = "zmk,behavior-hold-tap";
            #binding-cells = <2>;
            tapping-term-ms = <200>;
            quick-tap-ms = <150>;
            flavor = "balanced";
            bindings = <&kp>, <&kp>;
            hold-trigger-key-positions = <KEYS_R THUMBS>;
            hold-trigger-on-release;
        };
        amr: alpha_mods_r {
            compatible = "zmk,behavior-hold-tap";
            #binding-cells = <2>;
            tapping-term-ms = <250>;
            quick-tap-ms = <150>;
            flavor = "balanced";
            bindings = <&kp>, <&kp>;
            hold-trigger-key-positions = <KEYS_L THUMBS>;
            hold-trigger-on-release;
            require-prior-idle-ms = <100>;
        };
        asr: alpha_shift_r {
            compatible = "zmk,behavior-hold-tap";
            #binding-cells = <2>;
            tapping-term-ms = <200>;
            quick-tap-ms = <150>;
            flavor = "balanced";
            bindings = <&kp>, <&kp>;
            hold-trigger-key-positions = <KEYS_L THUMBS>;
            hold-trigger-on-release;
        };
        ht: hold_tap {
            compatible = "zmk,behavior-hold-tap";
            #binding-cells = <2>;
            tapping-term-ms = <200>;
            quick-tap-ms = <150>;
            flavor = "balanced";
            bindings = <&kp>, <&kp>;
        };
        // sticky key to be used for alt-tab macro
        sk_at: sk_alttabber {
            compatible = "zmk,behavior-sticky-key";
            #binding-cells = <1>;
            bindings = <&kp>;
            release-after-ms = <500>;
        };
    };

    macros {
        ZMK_MACRO(sleep,
            wait-ms = <500>;
            tap-ms = <10>;
            bindings
                = <&macro_tap &kp LG(X) &kp U &kp S>;
        )
        ZMK_MACRO(alt_tabber,  // adapted from @moutis on ZMK Discord
            wait-ms = <10>;
            tap-ms = <10>;
            bindings = <&macro_press &kp LALT>    // leave ALT down to keep menu up
                     , <&macro_tap &kp TAB>       // open the menu
                     , <&macro_pause_for_release> // wait until key release
                     , <&macro_tap &sk_at RALT>   // start timer to release ALT after timeout
                     , <&macro_release &kp LALT>; // now release the initial hold
        )
    };

    keymap {
        compatible = "zmk,keymap";

        default_layer {
            display-name = "DEF";
            bindings = <LAYER_FROM38( \
//           ╭──────────────┬──────────────┬──────────────┬──────────────┬──────────────╮   ╭──────────────┬──────────────┬──────────────┬──────────────┬──────────────╮
              &kp Q,         &kp W,         &kp E,         &kp R,         &kp T,             &kp Y,         &kp U,         &kp I,         &kp O,         &kp P, \
              &aml LGUI A,   &aml LALT S,   &aml LCTRL D,  &asl LSHFT F,  &kp G,             &kp H,         &asr LSHFT J,  &amr LCTRL K,  &amr LALT L,   &aml LGUI SQT, \
&kp ESC,      &kp Z,         &kp X,         &kp C,         &kp V,         &kp B,             &kp N,         &kp M,        &amr RCTRL COMMA, &amr RALT DOT, &kp SLASH,   &kp RET, \
                                            &kp ESC,       &lt NUM SPACE, &lt SYM TAB,       MS_ACT(RET),   &lt NAV BSPC,  &kp DEL \
//                                         ╰─────────────┴──────────────┴──────────────╯    ╰──────────────┴──────────────┴──────────────╯
            )>;
        };

        number_layer {
            display-name = "NUM";
            bindings = <LAYER_FROM38( \
//           ╭──────────────┬──────────────┬──────────────┬──────────────┬──────────────╮   ╭──────────────┬──────────────┬──────────────┬──────────────┬──────────────╮
              &none,         &alt_tabber,   &kp TAB_RT,    &kp TAB_LT,    &ht LA(F4) LC(F4), &kp LBKT,      &kp N7,        &kp N8,        &kp N9,        &kp RBKT,\
              &kp LGUI,      &kp LALT,      &kp LCTRL,     &kp LSHFT,     &to NAV,           &kp EQUAL,     &kp N4,        &kp N5,        &kp N6,        &kp SEMI,\
&kp ESC,      &kp LC(Z),     &kp LC(X),     &kp LC(C),     &kp LC(V),     &kp LC(Y),         &kp BSLH,      &kp N1,        &kp N2,        &kp N3,        &kp GRAVE,     &kp RET, \
                                            &trans,        &trans,        &trans,            &kp MINUS,     &kp N0,        &kp DOT \
//                                         ╰──────────────┴──────────────┴──────────────╯   ╰──────────────┴──────────────┴──────────────╯
            )>;
        };

        symbol_layer {
            display-name = "SYM";
            bindings = <LAYER_FROM38( \
//           ╭──────────────┬──────────────┬──────────────┬──────────────┬──────────────╮   ╭──────────────┬──────────────┬──────────────┬──────────────┬──────────────╮
              &kp F12,       &kp F7,        &kp F8,        &kp F9,        &kp PSCRN,         &kp LBRC,      &kp AMPS,      &kp ASTRK,     &kp LPAR,      &kp RBRC, \
              &kp F11,       &kp F4,        &kp F5,        &kp F6,        &kp SLCK,          &aml LSHFT PLUS, &aml LCTRL DLLR, &aml LALT PRCNT, &asl LGUI CARET, &kp COLON, \
&kp ESC,      &kp F10,       &kp F1,        &kp F2,        &kp F3,        &kp PAUSE_BREAK,   &kp PIPE,      &kp EXCL,      &kp AT,        &kp HASH,      &kp TILDE,     &kp RET, \
                                            &trans,        &trans,        &trans,            &kp UNDER,     &kp RPAR,      &kp LPAR \
//                                         ╰──────────────┴──────────────┴──────────────╯   ╰──────────────┴──────────────┴──────────────╯
            )>;
        };

        navigation_layer {
            display-name = "NAV";
            bindings = <LAYER_FROM38( \
//           ╭──────────────┬──────────────┬──────────────┬──────────────┬──────────────╮   ╭──────────────┬──────────────┬──────────────┬──────────────┬──────────────╮
              &kp PG_UP,     &kp END,      &kp UP,         &kp HOME,      &kp INS,           &ht LA(F4) LC(F4), &kp TAB_LT, &kp TAB_RT,   &alt_tabber,   &none, \
              &kp PG_DN,     &kp LEFT,     &kp DOWN,       &kp RIGHT,     &kp CAPS,          &to NUM,       &kp LSHFT,     &kp LCTRL,     &kp LALT,      &kp LGUI, \
&kp ESC,      &kp C_STOP,    &kp C_PREV,    &kp C_NEXT,    &kp C_VOL_UP,  &kp C_VOL_DN,      &kp LC(Y),     &kp LC(V),     &kp LC(C),     &kp LC(X),     &kp LC(Z),     &kp RET, \
                                            &trans,        &trans,        &trans,            &trans,        &trans,        &trans \
//                                         ╰──────────────┴──────────────┴──────────────╯   ╰──────────────┴──────────────┴──────────────╯
            )>;
        };

#ifdef MOUSE_KEYS
        mouse_layer {
            display-name = "MSE";
            bindings = <LAYER_FROM38( \
//           ╭──────────────┬──────────────┬──────────────┬──────────────┬──────────────╮   ╭──────────────┬──────────────┬──────────────┬──────────────┬──────────────╮
              &msc SCRL_UP,  &msc SCRL_LEFT, &mmv MOVE_UP, &msc SCRL_RIGHT, &kp C_AL_CALC,   &none,         &none,         &none,         &none,         &none, \
              &msc SCRL_DOWN, &mmv MOVE_LEFT, &mmv MOVE_DOWN, &mmv MOVE_RIGHT, &kp K_APP,    &none,         &none,         &none,         &none,         &none, \
&kp ESC,      &bt BT_CLR_ALL, &bt BT_SEL 0, &bt BT_SEL 1,  &bt BT_SEL 2,  &bt BT_CLR,        &none,         &none,         &none,         &none,         &none,        &kp RET, \
                                            &trans,        &trans,        &trans,            &mkp RCLK,     &mkp LCLK,     &none \
//                                         ╰──────────────┴──────────────┴──────────────╯   ╰──────────────┴──────────────┴──────────────╯
            )>;
        };
#endif
    };
};
