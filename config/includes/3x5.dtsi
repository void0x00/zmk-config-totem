#include <behaviors.dtsi>
#include <dt-bindings/zmk/keys.h>
#include <dt-bindings/zmk/bt.h>
// #include <dt-bindings/zmk/outputs.h>
// #include <dt-bindings/zmk/rgb.h>
// #include <dt-bindings/zmk/ext_power.h>

// Layer aliases
#define DEF 0
#define NUM 1
#define SYM 2
#define NAV 3
#define MSE 4

// shortcut select os
#defined MAC_OS
// homerow mode
  #define M_LSH LSHFT
  #define M_LCT LGUI
  #define M_LAL LALT
  #define M_LGU LCTRL
  #define M_RAL CAPS
// clipboard shortcut
  #define C_RDO LG(LS(Z))
  #define C_PST LG(V)
  #define C_CPY LG(C)
  #define C_CUT LG(X)
  #define C_UND LG(Z)
// Desktop and tab navigation shortcuts
  #define W_CLS LG(Q)
  #define T_CLS LG(W)
  #define T_RHT LC(TAB)
  #define T_LFT LC(LS(TAB))
  #define W_RHT LG(TAB)
  #define W_LFT LG(LS(TAB))
#elseif
// homerow mode
  #define M_LSH LSHFT
  #define M_LCT LCTRL
  #define M_LAL LALT
  #define M_LGU LGUI
  #define M_RAL RALT
// clipboard shortcut
  #define C_RDO LC(Y)
  #define C_PST LC(V)
  #define C_CPY LC(C)
  #define C_CUT LC(X)
  #define C_UND LC(Z)
// Desktop and tab navigation shortcuts
  #define W_CLS LA(F4)
  #define T_CLS LC(F4)
  #define T_RHT LC(TAB)
  #define T_LFT LC(LS(TAB))
  #define W_RHT LA(TAB)
  #define W_LFT LA(LS(TAB))
#endif

#include "combos.dtsi"

#ifdef MOUSE_KEYS
#    include "mouse.dtsi"
#    define MS_ACT(key) &lt MSE key
#else
#    define MS_ACT(key) &kp key
#endif

&mt {
    flavor = "hold-preferred";
    tapping-term-ms = <150>;
};

&lt {
    flavor = "balanced";
    tapping-term-ms = <150>;
};

&caps_word {
    continue-list = <UNDERSCORE MINUS BSPC DEL N1 N2 N3 N4 N5 N6 N7 N8 N9 N0>;
};

/ {
    behaviors {
        aml: alpha_mods_l {
            compatible = "zmk,behavior-hold-tap";
            #binding-cells = <2>;
            tapping-term-ms = <200>;
            quick-tap-ms = <150>;
            flavor = "balanced";
            bindings = <&kp>, <&kp>;
            hold-trigger-key-positions = <KEYS_R THUMBS>;
            hold-trigger-on-release;
            require-prior-idle-ms = <100>;
        };
        asl: alpha_shift_l {
            compatible = "zmk,behavior-hold-tap";
            #binding-cells = <2>;
            tapping-term-ms = <200>;
            quick-tap-ms = <150>;
            flavor = "balanced";
            bindings = <&kp>, <&kp>;
            hold-trigger-key-positions = <KEYS_R THUMBS>;
            hold-trigger-on-release;
        };
        amr: alpha_mods_r {
            compatible = "zmk,behavior-hold-tap";
            #binding-cells = <2>;
            tapping-term-ms = <250>;
            quick-tap-ms = <150>;
            flavor = "balanced";
            bindings = <&kp>, <&kp>;
            hold-trigger-key-positions = <KEYS_L THUMBS>;
            hold-trigger-on-release;
            require-prior-idle-ms = <100>;
        };
        asr: alpha_shift_r {
            compatible = "zmk,behavior-hold-tap";
            #binding-cells = <2>;
            tapping-term-ms = <200>;
            quick-tap-ms = <150>;
            flavor = "balanced";
            bindings = <&kp>, <&kp>;
            hold-trigger-key-positions = <KEYS_L THUMBS>;
            hold-trigger-on-release;
        };
        ht: hold_tap {
            compatible = "zmk,behavior-hold-tap";
            #binding-cells = <2>;
            tapping-term-ms = <200>;
            quick-tap-ms = <150>;
            flavor = "balanced";
            bindings = <&kp>, <&kp>;
        };
        // sticky key to be used for alt-tab macro
        sk_at: sk_alttabber {
            compatible = "zmk,behavior-sticky-key";
            #binding-cells = <1>;
            bindings = <&kp>;
            release-after-ms = <500>;
        };
    };

    macros {
        ZMK_MACRO(sleep,
            wait-ms = <500>;
            tap-ms = <10>;
            bindings
                = <&macro_tap &kp LG(X) &kp U &kp S>;
        )
    };

    keymap {
        compatible = "zmk,keymap";

        default_layer {
            display-name = "DEF";
            bindings = <LAYER_FROM38( \
//           ╭──────────────┬──────────────┬──────────────┬──────────────┬──────────────╮   ╭──────────────┬──────────────┬──────────────┬──────────────┬──────────────╮
              &kp Q,         &kp W,         &kp E,         &kp R,         &kp T,             &kp Y,         &kp U,         &kp I,         &kp O,         &kp P, \
              &aml M_LGU A,  &aml M_LAL S,  &aml M_LCT D,  &asl M_LSH F,  &kp G,             &kp H,         &asr M_LSH J,  &amr M_LCT K,  &amr M_LAL L,  &aml M_LGU SQT, \
&kp ESC,      &kp Z,         &kp X,         &kp C,         &kp V,         &kp B,             &kp N,         &kp M,         &amr M_RAL COMMA, &amr RALT DOT, &kp SLASH,   &kp RET, \
                                            &kp ESC,       &lt NAV SPACE, MS_ACT(TAB),       &lt SYM RET,   &lt NUM BSPC,  &kp DEL \
//                                         ╰─────────────┴──────────────┴──────────────╯    ╰──────────────┴──────────────┴──────────────╯
            )>;
        };

        number_layer {
            display-name = "NUM";
            bindings = <LAYER_FROM38( \
//           ╭──────────────┬──────────────┬──────────────┬──────────────┬──────────────╮   ╭──────────────┬──────────────┬──────────────┬──────────────┬──────────────╮
              &kp LBKT,      &kp N7,        &kp N8,        &kp N9,        &kp RBKT,          &ht W_CLS T_CLS, &kp T_LFT,   &kp T_RHT,     &kp W_LFT,     &kp W_RHT, \
              &kp SEMI,      &kp N4,        &kp N5,        &kp N6,        &kp EQUAL,         &to NAV,       &kp M_LSH,     &kp M_LCT,     &kp M_LAL,     &kp M_LGU, \
&kp ESC,      &kp GRAVE,     &kp N1,        &kp N2,        &kp N3,        &kp BSLH,          &kp C_RDO,     &kp C_PST,     &kp C_CPY,     &kp C_CUT,     &kp C_UND,     &kp RET, \
                                            &kp DOT,       &kp N0,        &kp MINUS,         &trans,        &trans,        &trans \
//                                         ╰──────────────┴──────────────┴──────────────╯   ╰──────────────┴──────────────┴──────────────╯
            )>;
        };

        symbol_layer {
            display-name = "SYM";
            bindings = <LAYER_FROM38( \
//           ╭──────────────┬──────────────┬──────────────┬──────────────┬──────────────╮   ╭──────────────┬──────────────┬──────────────┬──────────────┬──────────────╮
              &kp LBRC,      &kp AMPS,      &kp ASTRK,     &kp LPAR,      &kp RBRC,          &kp PSCRN,     &kp F7,        &kp F8,        &kp F9,        &kp F12, \
              &aml M_LGU COLON, &aml M_LAL DLLR, &aml M_LCT PRCNT, &asl M_LSH CARET, &kp PLUS, &kp SLCK,    &kp F4,        &kp F5,        &kp F6,        &kp F11, \
&kp ESC,      &kp TILDE,     &kp EXCL,      &kp AT,        &kp HASH,      &kp PIPE,        &kp PAUSE_BREAK, &kp F1,        &kp F2,        &kp F3,        &kp F10,       &kp RET, \
                                            &kp LPAR,      &kp RPAR,      &kp UNDER,         &trans,        &trans,        &trans \
//                                         ╰──────────────┴──────────────┴──────────────╯   ╰──────────────┴──────────────┴──────────────╯
            )>;
        };

        navigation_layer {
            display-name = "NAV";
            bindings = <LAYER_FROM38( \
//           ╭──────────────┬──────────────┬──────────────┬──────────────┬──────────────╮   ╭──────────────┬──────────────┬──────────────┬──────────────┬──────────────╮
              &kp W_RHT,     &kp W_LFT,     &kp T_RHT,     &kp T_LFT,     &ht W_CLS T_CLS,   &kp INS,       &kp HOME,      &kp UP,        &kp END,       &kp PG_UP, \
              &kp M_LGU,     &kp M_LAL,     &kp M_LCT,     &kp M_LSH,     &to NUM,           &kp CAPS,      &kp LEFT,      &kp DOWN,      &kp RIGHT,     &kp PG_DN, \
&kp ESC,      &kp C_UND,     &kp C_CUT,     &kp C_CPY,     &kp C_PST,     &kp C_RDO,         &kp C_STOP,    &kp C_PREV,    &kp C_NEXT,    &kp C_VOL_UP,  &kp C_VOL_DN,  &kp RET, \
                                            &trans,        &trans,        &trans,            &kp RET,       &kp BSPC,      &kp DEL \
//                                         ╰──────────────┴──────────────┴──────────────╯   ╰──────────────┴──────────────┴──────────────╯
            )>;
        };

#ifdef MOUSE_KEYS
        mouse_layer {
            display-name = "MSE";
            bindings = <LAYER_FROM38( \
//           ╭──────────────┬──────────────┬──────────────┬──────────────┬──────────────╮   ╭──────────────┬──────────────┬──────────────┬──────────────┬──────────────╮
              &none,         &none,         &none,         &none,         &none,             &kp C_AL_CALC, &msc SCRL_LEFT, &mmv MOVE_UP,  &msc SCRL_RIGHT, &msc SCRL_UP, \
              &none,         &none,         &none,         &none,         &none,             &kp K_APP,    &mmv MOVE_LEFT, &mmv MOVE_DOWN, &mmv MOVE_RIGHT, &msc SCRL_DOWN, \
&kp ESC,      &none,         &none,         &none,         &none,         &none,             &bt BT_CLR_ALL, &bt BT_SEL 0, &bt BT_SEL 1,  &bt BT_SEL 2,  &bt BT_CLR,    &kp RET, \
                                            &trans,        &trans,        &trans,            &mkp RCLK,     &mkp LCLK,     &none \
//                                         ╰──────────────┴──────────────┴──────────────╯   ╰──────────────┴──────────────┴──────────────╯
            )>;
        };
#endif
    };
};
