## config/west.yml
```yaml
manifest:
  remotes:
    - name: zmkfirmware
      url-base: https://github.com/zmkfirmware
    - name: caksoylar
      url-base: https://github.com/caksoylar
  projects:
#    - name: zmk
#      remote: zmkfirmware
#      revision: main
#      import: app/west.yml
# Change to use mouse.dtsi
    - name: zmk
      remote: caksoylar
      revision: caksoylar/zen-8bit
      import: app/west.yml
    - name: zmk-rgbled-widget
      remote: caksoylar
      revision: main
  self:
    path: config
```
